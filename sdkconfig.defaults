## sdkconfig.defaults
```kconfig
# Target SoC. Pinned so a stray sdkconfig regeneration can't silently fall back
# to IDF's default 'esp32' target (which breaks the esp32s3 build: PSRAM, the
# AXS15231B display, and the 16MB layout all assume esp32s3). Without this, an
# `idf.py build` that has to regenerate sdkconfig produces an esp32 config that
# mismatches the CMake cache and aborts.
CONFIG_IDF_TARGET="esp32s3"

# ESP32-S3 CPU & Frequency settings
CONFIG_ESP32S3_DEFAULT_CPU_FREQ_240=y
CONFIG_ESP32S3_DEFAULT_CPU_FREQ_MHZ=240

# SPIRAM (OPI PSRAM) Configurations
#
# ⚠ HARD PSRAM REQUIREMENT (audit #71). This image targets the S3R8 (ESP32-S3
# with 8 MB octal PSRAM). CONFIG_SPIRAM_BOOT_INIT=y below initialises PSRAM in
# the bootloader; on an S3 module WITHOUT octal PSRAM that init panics at boot
# with no usable diagnostic (and the display framebuffer alloc asserts anyway).
# Do NOT flash this image to a non-PSRAM module. If a cross-board image is ever
# needed, add CONFIG_SPIRAM_IGNORE_NOTFOUND=y so a missing chip degrades to a
# warning instead of a brick — deliberately omitted here so a silent PSRAM-off
# drift (regenerated sdkconfig) fails loudly at build/boot rather than shipping a
# half-functional unit.
CONFIG_SPIRAM=y
CONFIG_SPIRAM_TYPE_AUTO=y
CONFIG_SPIRAM_MODE_OCT=y
CONFIG_SPIRAM_SPEED_80M=y
CONFIG_SPIRAM_BOOT_INIT=y
CONFIG_SPIRAM_USE_MALLOC=y
CONFIG_SPIRAM_MALLOC_RESERVE_INTERNAL=32768
CONFIG_SPIRAM_MEMTEST=n

# Flash Settings (16MB QIO)
CONFIG_ESPTOOLPY_FLASHMODE_QIO=y
CONFIG_ESPTOOLPY_FLASHFREQ_80M=y
CONFIG_ESPTOOLPY_FLASHSIZE_16MB=y
CONFIG_ESPTOOLPY_FLASHSIZE="16MB"

# Common ESP system settings
CONFIG_ESP_DEFAULT_CPU_FREQ_MHZ_240=y
CONFIG_FREERTOS_HZ=1000

# LVGL Config overrides (if using custom lv_conf.h, or via Kconfig)
CONFIG_LV_CONF_SKIP=y
CONFIG_LV_COLOR_DEPTH_16=y
CONFIG_LV_COLOR_DEPTH=16
# AXS15231B QSPI expects byte-swapped RGB565 (the working reference sets swap_bytes=1).
# Without this, bright colors come out near-black because the two bytes are reversed.
CONFIG_LV_COLOR_16_SWAP=y
CONFIG_LV_MEM_SIZE_KILOBYTES=64
CONFIG_LV_MEM_CUSTOM=y
CONFIG_LV_TICK_CUSTOM=y
CONFIG_LV_TICK_CUSTOM_INCLUDE="esp_timer.h"
CONFIG_LV_TICK_CUSTOM_SYS_TIME_EXPR="esp_timer_get_time() / 1000"

# User requested additions for CI build fix
CONFIG_COMPILER_CXX_EXCEPTIONS=y
CONFIG_ETH_USE_SPI_ETHERNET=y
CONFIG_ETH_SPI_ETHERNET_W5500=y
CONFIG_PARTITION_TABLE_CUSTOM=y
CONFIG_PARTITION_TABLE_CUSTOM_FILENAME="partitions.csv"

# OTA (Phase-1 production hardening) — see docs/OTA.md.
# Enables the bootloader anti-rollback / app-validation workflow so a freshly
# flashed OTA image boots in the "pending verify" state and is rolled back to the
# previous slot on the next reset UNLESS the app calls
# esp_ota_mark_app_valid_cancel_rollback() (we do this on a clean boot via
# OtaUpdater::markValid()). This is the single canonical Kconfig symbol for the
# feature in ESP-IDF v5.x; there is no separate CONFIG_APP_ROLLBACK_ENABLE.
CONFIG_BOOTLOADER_APP_ROLLBACK_ENABLE=y


# The HTTP dashboard's accept loop runs as a std::thread (pthread). handleClient
# -> sendApiStatus builds a JSON response + snapshot vector copies that overflow
# the 3 KB default pthread stack on-device (works on host where threads have
# MB-sized stacks; that mismatch made the dashboard unreachable on a real LAN
# while SIP, on a properly-sized FreeRTOS task, kept working). Give std::thread
# tasks a realistic stack.
CONFIG_PTHREAD_TASK_STACK_SIZE_DEFAULT=8192

# wolfSSL (display/SSH build only). The wolfSSL ESP component emits a #warning
# "RSA may be difficult with less than 10KB Stack" when CONFIG_ESP_MAIN_TASK_STACK_SIZE
# < 10500. Under IDF v6.0.1's -Werror=cpp a #warning is a hard error. The wolfSSH
# server runs in its own 24KB task (not the main task) and uses ECC, not RSA, so the
# warning is irrelevant here — suppress it via the wolfSSL-provided Kconfig escape hatch.
# (Harmless/ignored for non-display builds that don't link wolfSSL.)
CONFIG_ESP_WOLFSSL_NO_STACK_SIZE_BUILD_WARNING=y

# ─────────────────────────────────────────────────────────────────────────────
# Secrets-at-rest hardening (issue #58 / #47, THREAT_MODEL I-3/I-5/I-6, T-4/T-5).
#
# The device stores recoverable secrets in NVS: the per-extension SIP digest
# credential (HA1 — a *bearer* credential, by protocol necessity not a one-way
# hash), the upstream WiFi station password (cleartext), and any trunk credentials.
# Until flash is encrypted, a physical attacker who reads the SPI flash recovers
# all of them. There is NO sound application-layer fix (any key the app could use
# to encrypt NVS would itself sit in the same readable flash) — the durable control
# is ESP-IDF **flash encryption** (hardware-key, transparent NVS encryption) plus
# **Secure Boot v2** (which also closes the unsigned-OTA boot path, #47/T-5).
#
# These are LEFT COMMENTED ON PURPOSE: enabling them burns eFuses on first boot and
# is IRREVERSIBLE — it will brick a dev board for re-flashing and must be a
# deliberate production/factory decision with a provisioned signing key. To enable
# for a production build (see docs/THREAT_MODEL.md §7 P2 and docs/OTA.md §6):
#
#   # Flash encryption (encrypts app + NVS at rest; protects HA1 / WiFi pass).
#   CONFIG_SECURE_FLASH_ENC_ENABLED=y
#   CONFIG_SECURE_FLASH_ENCRYPTION_MODE_RELEASE=y      # release mode: no UART reflash
#
#   # Secure Boot v2 (bootloader verifies the app's ECDSA-P256 signature; the same
#   # key signs OTA images verified by OtaUpdater::verifySignature(), issue #47).
#   CONFIG_SECURE_BOOT=y
#   CONFIG_SECURE_BOOT_V2_ENABLED=y
#   CONFIG_SECURE_BOOT_SIGNING_KEY="secure_boot_signing_key.pem"
#
#   # Make esp_ota_* itself verify the appended signature on every OTA write, even
#   # without full Secure Boot, as a belt-and-suspenders layer alongside the
#   # app-layer X-OTA-Signature check:
#   CONFIG_SECURE_SIGNED_APPS_NO_SECURE_BOOT=y
#   CONFIG_SECURE_SIGNED_ON_UPDATE_NO_SECURE_BOOT=y
# ─────────────────────────────────────────────────────────────────────────────

# LWIP socket pool — open the W5500 path up. The W5500 runs in MACRAW mode, so the
# ESP32-S3's LWIP stack (NOT the W5500's 8-socket hardware TCP engine) owns every
# connection — the real cap is this knob, default 10. That's too tight for the WAN
# anchor (3CX call-control) path: the control WebSocket + the GET and POST audio
# streams are THREE persistent TLS sockets, on top of SIP (UDP), the HTTP dashboard,
# SSH and OPTIONS pings. Exhaustion shows up as socket() returning < 0 ("sock < 0")
# and mbedTLS create_ssl_handle failing — the audio stream can't reconnect and the
# participant-drop POST can't open, so the PSTN leg lingers. Bump the pool (cheap:
# a few hundred bytes of internal RAM per slot, and there is ~300 KB free).
# #100 multi-call: sized for up to ~8 concurrent anchor calls. Each bridged call draws FOUR
# sockets — GET + POST TLS audio streams (WAN) AND its own RtpReceiver + RtpSender (LAN UDP),
# i.e. 4N — plus the shared control WS (+1) and ctrl (+1), plus transient makecall/resolve/
# getLegStatus GETs during setup, on top of SIP/dashboard/SSH/OPTIONS. 4*8 + ~8 baseline ≈ 40,
# +setup transients, so 48 is the N=8 envelope (hardware ramp finds the real edge; symmetric RTP
# would later fold the LAN pair into one socket). Hardware-confirmed: socket() FAILED at the
# 3rd-4th call with the old 16/24 pool. Past ~8 is the P4 platform, not a config bump.
CONFIG_LWIP_MAX_SOCKETS=48

# ── mbedTLS internal-RAM relief (#94) ────────────────────────────────────────
# The hard wall on hangup was not just sockets: a 4th TLS context (the drop POST)
# fails with `mbedtls_ssl_setup returned -0x008D` (alloc-fail) and the 12 KB drop
# worker stack won't allocate — because mbedTLS allocates its per-connection
# buffers from the ~320 KB INTERNAL DRAM by default, NOT the 8 MB octal PSRAM
# (which sits idle). During an active call the 3 persistent anchor TLS streams
# (WS + GET + POST) exhaust internal RAM, so the leg can't be dropped until the
# far end hangs up. Two levers:
#   DYNAMIC_BUFFER: size/free each connection's TLS I/O buffers on demand instead
#                   of pinning the full ~16 KB record each — frees tens of KB.
#   EXTERNAL_MEM_ALLOC: place mbedTLS allocations in PSRAM (DMA-capable buffers for
#                   the HW crypto accelerators still go internal automatically), so
#                   the 4th TLS context allocates from the 8 MB instead of starving
#                   the internal heap. Requires CONFIG_SPIRAM_USE_MALLOC=y (set above).
CONFIG_MBEDTLS_DYNAMIC_BUFFER=y
CONFIG_MBEDTLS_EXTERNAL_MEM_ALLOC=y

# ── LWIP IRAM optimization (jitter) ──────────────────────────────────────────
# Pull the LWIP hot path into IRAM so the core network/UDP processing is never
# stalled by a flash-cache miss — lowers and de-jitters RTP/SIP latency. Costs
# some IRAM (tight budget), so the build must be checked for an IRAM overflow.
CONFIG_LWIP_IRAM_OPTIMIZATION=y

# ── TLS session resumption (#93) ─────────────────────────────────────────────
# Cache TLS session tickets so a reconnect resumes (abbreviated handshake, ~1 RTT)
# instead of re-running the full ECDHE — which is software-bound on the S3 (no ECC
# accelerator). Prerequisite for esp_http_client's save_client_session flag, which
# the anchor sets in makeAuthedClient(); paired with the control-plane pre-warm so the
# first dial resumes the already-warmed session.
CONFIG_ESP_TLS_CLIENT_SESSION_TICKETS=y
CONFIG_MBEDTLS_CLIENT_SSL_SESSION_TICKETS=y
```
